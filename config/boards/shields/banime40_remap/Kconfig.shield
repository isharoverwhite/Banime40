## config/boards/shields/banime40_remap/Kconfig.shield
```kconfig
config SHIELD_BANIME40_REMAP
    def_bool $(shields_list_contains,banime40_remap)
```

## config/west.yml
```yaml
manifest:
  remotes:
    - name: zmkfirmware
      url-base: https://github.com/zmkfirmware
  projects:
    - name: zmk
      remote: zmkfirmware
      revision: v4.1-branch+zmk
      import: app/west.yml
  self:
    path: config
```
